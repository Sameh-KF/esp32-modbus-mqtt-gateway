## firmware/gateway/main/Kconfig.projbuild
```kconfig
menu "Gateway WiFi"
    config ESP_WIFI_SSID
        string "WiFi SSID"
        default ""
    config ESP_WIFI_PASSWORD
        string "WiFi password"
        default ""
endmenu

menu "Gateway MQTT"
    config APP_MQTT_URI
        string "MQTT broker URI (without credentials)"
        default "mqtt://192.168.1.10:1883"
    config APP_MQTT_USERNAME
        string "MQTT username"
        default ""
    config APP_MQTT_PASSWORD
        string "MQTT password"
        default ""
endmenu

menu "Gateway clock"
    config APP_SNTP_SERVER
        string "SNTP server (LAN NTP or public host)"
        default "pool.ntp.org"
endmenu
```

## firmware/gateway/sdkconfig.defaults
```kconfig
CONFIG_IDF_TARGET="esp32s3"
CONFIG_ESPTOOLPY_FLASHMODE_DIO=y
CONFIG_ESPTOOLPY_FLASHFREQ_80M=y
CONFIG_ESPTOOLPY_FLASHSIZE_16MB=y
# CONFIG_ESPTOOLPY_FLASH_MODE_AUTO_DETECT is not set
# CONFIG_PARTITION_TABLE_SINGLE_APP is not set
CONFIG_PARTITION_TABLE_CUSTOM=y
CONFIG_PARTITION_TABLE_CUSTOM_FILENAME="partitions.csv"
# CONFIG_SPIRAM is not set

# The separate board USB-UART bridge is COM9, UART0, 115200 baud.
CONFIG_ESP_CONSOLE_UART_CUSTOM=y
CONFIG_ESP_CONSOLE_UART_CUSTOM_NUM_0=y
CONFIG_ESP_CONSOLE_UART_TX_GPIO=43
CONFIG_ESP_CONSOLE_UART_RX_GPIO=44
CONFIG_ESP_CONSOLE_UART_BAUDRATE=115200
CONFIG_ESP_CONSOLE_SECONDARY_NONE=y
CONFIG_LOG_DEFAULT_LEVEL_INFO=y

CONFIG_MQTT_USE_CUSTOM_CONFIG=y
CONFIG_MQTT_REPORT_DELETED_MESSAGES=y
CONFIG_MQTT_OUTBOX_EXPIRED_TIMEOUT_MS=3000
```
